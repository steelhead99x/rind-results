#include <stdint.h>
#include <avr/pgmspace.h>

static const uint8_t sha256_empty[32] PROGMEM = {
    0xe3,0xb0,0xc4,0x42,0x98,0xfc,0x1c,0x14,0x9a,0xfb,0xf4,0xc8,0x99,0x6f,0xb9,0x24,
    0x27,0xae,0x41,0xe4,0x64,0x9b,0x93,0x4c,0xa4,0x95,0x99,0x1b,0x78,0x52,0xb8,0x55
};
static const uint8_t sha256_abc[32] PROGMEM = {
    0xba,0x78,0x16,0xbf,0x8f,0x01,0xcf,0xea,0x41,0x41,0x40,0xde,0x5d,0xae,0x22,0x23,
    0xb0,0x03,0x61,0xa3,0x96,0x17,0x7a,0x9c,0xb4,0x10,0xff,0x61,0xf2,0x00,0x15,0xad
};
static const uint8_t sha512_abc[64] PROGMEM = {
    0xdd,0xaf,0x35,0xa1,0x93,0x61,0x7a,0xba,0xcc,0x41,0x73,0x49,0xae,0x20,0x41,0x31,
    0x12,0xe6,0xfa,0x4e,0x89,0xa9,0x7e,0xa2,0x0a,0x9e,0xee,0xe6,0x4b,0x55,0xd3,0x9a,
    0x21,0x92,0x99,0x2a,0x27,0x4f,0xc1,0xa8,0x36,0xba,0x3c,0x23,0xa3,0xfe,0xeb,0xbd,
    0x45,0x4d,0x44,0x23,0x64,0x3c,0xe8,0x0e,0x2a,0x9a,0xc9,0x4f,0xa5,0x4c,0xa4,0x9f
};
static const uint8_t chacha_out[114] PROGMEM = {
    0x6e,0x2e,0x35,0x9a,0x25,0x68,0xf9,0x80,0x41,0xba,0x07,0x28,0xdd,0x0d,0x69,0x81,
    0xe9,0x7e,0x7a,0xec,0x1d,0x43,0x60,0xc2,0x0a,0x27,0xaf,0xcc,0xfd,0x9f,0xae,0x0b,
    0xf9,0x1b,0x65,0xc5,0x52,0x47,0x33,0xab,0x8f,0x59,0x3d,0xab,0xcd,0x62,0xb3,0x57,
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    0x87,0x4d
};
/* RFC 8439 2.4.2 plaintext */
static const uint8_t chacha_in[114] PROGMEM = {
    'L','a','d','i','e','s',' ','a','n','d',' ','G','e','n','t','l',
    'e','m','e','n',' ','o','f',' ','t','h','e',' ','c','l','a','s',
    's',' ','o','f',' ','\'','9','9',':',' ','I','f',' ','I',' ','c',
    'o','u','l','d',' ','o','f','f','e','r',' ','y','o','u',' ','o','n',
    'l','y',' ','o','n','e',' ','t','i','p',' ','f','o','r',' ','t','h',
    'e',' ','f','u','t','u','r','e',',',' ','s','u','n','s','c','r','e',
    'e','n',' ','w','o','u','l','d',' ','b','e',' ','i','t','.'
};
static const uint8_t poly_tag[16] PROGMEM = {
    0xa8,0x06,0x1d,0xc1,0x30,0x51,0x36,0xc6,0xc2,0x2b,0x8b,0xaf,0x0c,0x01,0x27,0xa9
};
static const uint8_t poly_key[32] PROGMEM = {
    0x85,0xd6,0xbe,0x78,0x57,0x55,0x6d,0x33,0x7f,0x44,0x52,0xfe,0x42,0xd5,0x06,0xa8,
    0x01,0x03,0x80,0x8a,0xfb,0x0d,0xb2,0xfd,0x4a,0xbf,0xf6,0xaf,0x41,0x49,0xf5,0x1b
};
static const uint8_t poly_msg[34] PROGMEM = {
    'C','r','y','p','t','o','g','r','a','p','h','i','c',' ','F','o',
    'r','u','m',' ','R','e','s','e','a','r','c','h',' ','G','r','o','u','p'
};

uint8_t kat_eq_p(const uint8_t *got, const uint8_t *src, uint16_t n) {
    for (uint16_t i = 0; i < n; i++) {
        if (got[i] != pgm_read_byte(&src[i])) return 0;
    }
    return 1;
}
uint8_t kat_eq_sha256_empty(const uint8_t *got) { return kat_eq_p(got, sha256_empty, 32); }
uint8_t kat_eq_sha256_abc(const uint8_t *got) { return kat_eq_p(got, sha256_abc, 32); }
uint8_t kat_eq_sha512_abc(const uint8_t *got) { return kat_eq_p(got, sha512_abc, 64); }
uint8_t kat_eq_chacha(const uint8_t *got) { return kat_eq_p(got, chacha_out, 114); }
uint8_t kat_eq_poly(const uint8_t *got) { return kat_eq_p(got, poly_tag, 16); }

static void load_p(uint8_t *dst, const uint8_t *src, uint16_t n) {
    for (uint16_t i = 0; i < n; i++) dst[i] = pgm_read_byte(&src[i]);
}
void kat_load_chacha_in(uint8_t *dst) { load_p(dst, chacha_in, 114); }
void kat_load_poly_key(uint8_t *dst) { load_p(dst, poly_key, 32); }
void kat_load_poly_msg(uint8_t *dst) { load_p(dst, poly_msg, 34); }
